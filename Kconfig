## Kconfig
```kconfig
# SPDX-License-Identifier: MIT
# Copyright (c) 2026 Scott Penrose <scottp@dd.com.au>

menuconfig RB9704
	bool "RockBLOCK 9704 Iridium modem"
	default y
	depends on DT_HAS_ROCK7_ROCKBLOCK_9704_ENABLED
	depends on SERIAL
	select RING_BUFFER
	select UART_INTERRUPT_DRIVEN
	help
	  Ground Control's RockBLOCK 9704 (Iridium Certus, IMT messages) on the
	  UART its devicetree node sits on. Builds Ground Control's library,
	  pinned pristine at modules/lib/rockblock9704, with a Zephyr serial
	  port and one worker thread that owns it. <rb9704/rb9704.h> is the API.

if RB9704

config RB9704_MESSAGE_MAX
	int "Largest message in either direction (bytes)"
	default 2048
	range 16 100000
	help
	  The modem takes up to 100 kB, and the library keeps one static buffer
	  of this size for messages out and one for messages in, plus one in
	  this module for the copy rb9704_send takes. 2 kB is three buffers of
	  2 kB; raise it as far as the RAM allows.

DT_COMPAT_ROCK7_ROCKBLOCK_9704 := rock7,rockblock-9704

config RB9704_POWER
	bool "Drive the power pins from devicetree"
	default y if $(dt_compat_any_has_prop,$(DT_COMPAT_ROCK7_ROCKBLOCK_9704),iridium-enable-gpios)
	select GPIO
	help
	  I_EN, I_BTD and P_EN as the devicetree node gives them, in Ground
	  Control's start-up and shutdown sequence. I_EN is the one that
	  switches the modem; without it the modem is taken to be powered, as
	  the board is with the pins left open.

config RB9704_WORKER_STACK_SIZE
	int "Worker thread stack size"
	default 8192
	help
	  Measured, not guessed: the library parks a 1.5 kB MT segment on the
	  stack in rbPoll(), with cJSON's recursion beneath it. A smaller stack
	  overflows only when a message arrives, which may be days after the
	  change.

config RB9704_WORKER_PRIORITY
	int "Worker thread priority"
	default 8

config RB9704_RX_RING_SIZE
	int "Serial receive ring (bytes)"
	default 8192
	help
	  The library's longest JSPR line is 8 kB.

config RB9704_SHELL
	bool "`rb9704` shell command"
	default y
	depends on SHELL

config RB9704_UPSTREAM_DIR
	string "Where Ground Control's library is"
	default ""
	help
	  Empty: <west topdir>/modules/lib/rockblock9704, where this
	  repository's west.yml puts it.

module = RB9704
module-str = rb9704
source "subsys/logging/Kconfig.template.log_config"

endif # RB9704
```

## dts/bindings/rock7,rockblock-9704.yaml
```yaml
# SPDX-License-Identifier: MIT
# Copyright (c) 2026 Scott Penrose <scottp@dd.com.au>

description: |
  RockBLOCK 9704, Ground Control's Iridium Certus (IMT) modem board, on a
  UART. The modem speaks JSPR, JSON lines over a fixed 230400 8N1; there is
  no AT mode. One per system: the library underneath keeps global state.

  The control pins are optional. With none, the modem is assumed powered and
  enabled, which is how the board behaves with the pins left open: I_EN
  has a pull-up and P_EN a pull-down. I_EN is what switches the modem, so
  power control needs iridium-enable-gpios; booted-gpios and power-gpios
  are each optional beside it.

compatible: "rock7,rockblock-9704"

include:
  - uart-device.yaml

properties:
  power-gpios:
    type: phandle-array
    description: |
      P_EN, header pin 6: the supercapacitor charge enable. It is active
      low on the board, so give GPIO_ACTIVE_LOW. Driven active (charging
      on) while the modem runs, and released to an input while it is off,
      where the board's pull-down keeps the charger on. Leaving it
      unconnected is fine.

  iridium-enable-gpios:
    type: phandle-array
    description: |
      I_EN, header pin 3: starts and stops the modem. Driven high to
      start it and low to stop it, and never moved back until I_BTD has
      followed.

  booted-gpios:
    type: phandle-array
    description: |
      I_BTD, header pin 7: high once the modem has booted, low once it has
      shut down. When present, start-up and shutdown wait for it instead
      of a fixed delay.

  boot-delay-ms:
    type: int
    default: 4000
    description: |
      How long to wait after moving I_EN, either way, when there is no
      booted-gpios to wait on.

examples:
  - |
    &usart3 {
            current-speed = <230400>;
            status = "okay";

            modem: rockblock {
                    compatible = "rock7,rockblock-9704";
                    power-gpios = <&gpiob 0 GPIO_ACTIVE_LOW>;
                    iridium-enable-gpios = <&gpiob 1 GPIO_ACTIVE_HIGH>;
                    booted-gpios = <&gpiob 2 GPIO_ACTIVE_HIGH>;
            };
    };
```
